## CMakeLists.txt
```
cmake_minimum_required(VERSION 3.13.1)
find_package(Zephyr REQUIRED HINTS $ENV{ZEPHYR_BASE})
project(shell)

target_sources(app PRIVATE src/main.c)
```

## prj.conf
```kconfig
CONFIG_SHELL=y
CONFIG_DEVICE_SHELL=y
CONFIG_KERNEL_SHELL=y
```

## src/main.c
```c
#include <zephyr.h>
#include <shell/shell.h>
#include <sys/printk.h>

void main(void)
{
    printk("Runnig shell\n");
}
```
